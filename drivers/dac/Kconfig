## drivers/dac/Kconfig
```kconfig
# DAC7x78 octal DAC configuration options

#
# Copyright (c) 2024 FKMG Circuits
#

menuconfig DAC7X78
	bool "DAC7x78 octal DAC"
	depends on I2C
	depends on DAC
	help
	  Enable the shared driver for TI DAC7578 and DAC7678 I2C DACs.

config DAC7578
	bool "Legacy DAC7578 driver option"
	depends on I2C
	depends on DAC
	select DAC7X78
	help
	  Compatibility option for projects that enabled this fork before it
	  supported both DAC7578 and DAC7678. New projects should use DAC7X78.

config DAC7578_INIT_PRIORITY
	int "Legacy initialization priority for TI DAC7578"
	default 80
	depends on DAC7578
	help
	  Compatibility option retained for old configurations. New projects
	  should use DAC7X78_INIT_PRIORITY.

config DAC7X78_INIT_PRIORITY
	int "Initialization priority for TI DAC7x78"
	default DAC7578_INIT_PRIORITY if DAC7578
	default 80
	depends on DAC7X78
	help
	  Set the initialization priority for the TI DAC7x78 driver.
```

## dts/bindings/dac/ti,dac7578.yaml
```yaml
# Copyright (c) 2026 Caltech Optical Observatories
# SPDX-License-Identifier: Apache-2.0

description: TI DAC7578 12-bit octal I2C DAC

compatible: "ti,dac7578"

include: [dac-controller.yaml, i2c-device.yaml]

properties:
  "#io-channel-cells":
    const: 1

  ti,clear-mode:
    type: string
    enum:
      - "default"
      - "zero-scale"
      - "midscale"
      - "full-scale"
      - "disabled"
    description: |
      Optional clear-code register initialization. "disabled" disables the
      external CLR pin in devices that support the DACx578 clear-code command.
      If omitted, the driver leaves the clear-code register unchanged at init.

  ti,reference:
    type: string
    enum:
      - "external"
    description: |
      DAC7578 uses the external supply/reference path; internal reference
      modes are only available on compatible DAC7678 devices. If omitted, the
      driver leaves reference configuration unchanged at init.

  ti,reset-on-init:
    type: boolean
    description: |
      Send the software-reset command during Zephyr device initialization. This
      can disturb analog outputs after an MCU-only reboot, so it is opt-in.

io-channel-cells:
  - output
```

## dts/bindings/dac/ti,dac7678.yaml
```yaml
# Copyright (c) 2026 Caltech Optical Observatories
# SPDX-License-Identifier: Apache-2.0

description: TI DAC7678 12-bit octal I2C DAC with 2.5 V internal reference

compatible: "ti,dac7678"

include: [dac-controller.yaml, i2c-device.yaml]

properties:
  "#io-channel-cells":
    const: 1

  ti,clear-mode:
    type: string
    enum:
      - "default"
      - "zero-scale"
      - "midscale"
      - "full-scale"
      - "disabled"
    description: |
      Optional clear-code register initialization. "disabled" disables the
      external CLR pin. If omitted, the driver leaves the clear-code register
      unchanged at init.

  ti,reference:
    type: string
    enum:
      - "external"
      - "internal-static"
      - "internal-flexible"
    description: |
      Reference configuration applied during init. "external" leaves the
      internal reference disabled. "internal-static" enables the internal
      reference using the static reference register. "internal-flexible"
      enables the flexible reference mode that keeps the reference powered
      regardless of DAC channel power-down state. If omitted, the driver leaves
      reference configuration unchanged at init.

  ti,reset-on-init:
    type: boolean
    description: |
      Send the software-reset command during Zephyr device initialization. This
      can disturb analog outputs after an MCU-only reboot, so it is opt-in.

io-channel-cells:
  - output
```
